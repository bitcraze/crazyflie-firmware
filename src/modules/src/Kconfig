## src/modules/src/Kconfig
```kconfig
menu "Controllers and Estimators"

choice
    prompt "Default controller"
    default CONFIG_CONTROLLER_AUTO_SELECT
    depends on !CONTROLLER_OOT

config CONTROLLER_AUTO_SELECT
    bool "Auto select Controller"
    help
        Do not care which controller is used, if any

config CONTROLLER_PID
    bool "PID controller"
    help
        Use the PID (proportional–integral–derivative) controller as default

config CONTROLLER_PID_FILTER_ALL
    bool "Apply LPF filter to all PID components"
    depends on CONTROLLER_PID
    help
        Apply a low pass filter to all PID components instead of only the D component (default)

config CONTROLLER_PID_IMPROVED_BARO_Z_HOLD
    bool "Use improved baro z hold"
    depends on CONTROLLER_PID_FILTER_ALL
    help
        Uses an improved z hold based on barometric pressure

config CONTROLLER_INDI
    bool "INDI controller"
    help
        Use the INDI (Incremental non-linear dynamic inversion) controller as default

config CONTROLLER_MELLINGER
    bool "Mellinger controller"
    help
        Use the Mellinger controller as default

config CONTROLLER_BRESCIANINI
    bool "Brescianini controller"
    help
        Use the Brescianini controller as default

config CONTROLLER_LEE
    bool "Lee controller"
    help
        Use the Lee controller as default

endchoice

config CONTROLLER_OOT
    bool "Out-of-tree controller"
    default n

config ESTIMATOR_KALMAN_ENABLE
    bool "Enable Kalman Estimator"
    default y
    select ESTIMATOR_OUTLIER_FILTERS
    help
        Enable the Kalman (EKF) estimator.

config ESTIMATOR_KALMAN_TDOA_OUTLIERFILTER_FALLBACK
    bool "Use 'old' TDoA outlier filter."
    default n
    depends on ESTIMATOR_KALMAN_ENABLE
    help
        Use the 'old' TDoA outlier filter instead of the default one. Deprecated, will be removed after September 2023.

config ESTIMATOR_KALMAN_GENERAL_PURPOSE
    bool "Configure the Kalman estimator for general purpose use"
    default n
    depends on ESTIMATOR_KALMAN_ENABLE
    help
        Configure the Kalman estimator for general purpose use and not for flying. In this mode the estimator will not
        use any drone specific information for state estimation, this is useful when using the Crazyflie as a general
        positioning tag (tracker).

config ESTIMATOR_KALMAN_INITIAL_YAW_STD
    int "Configure the initial yaw standard deviation in the Kalman filter."
    default 10
    depends on ESTIMATOR_KALMAN_ENABLE
    help
        The initial yaw standard deviation describes how uncertain the Kalman estimator assumes the yaw angle is at startup.
        Note that the entered value is in milliradians (mrad).

config ESTIMATOR_UKF_ENABLE
    bool "Enable error-state UKF estimator"
    select ESTIMATOR_OUTLIER_FILTERS
    default n
    help
        Enable the (error-state unscented) Kalman filter (UKF) estimator

config ESTIMATOR_OUTLIER_FILTERS
    bool
    help
        Include outlier filters for estimators

choice
    prompt "Default estimator"
    default CONFIG_ESTIMATOR_AUTO_SELECT
    depends on !ESTIMATOR_OOT

config ESTIMATOR_AUTO_SELECT
    bool "Auto select Estimator"
    help
        Do not care which estimator is used, if any

config ESTIMATOR_KALMAN
    bool "Kalman estimator"
    depends on ESTIMATOR_KALMAN_ENABLE
    help
        Use the (extended) Kalman filter (EKF) estimator as default

config ESTIMATOR_UKF
    bool "Error-state UKF estimator"
    depends on ESTIMATOR_UKF_ENABLE
    help
        Use the (error-state unscented) Kalman filter (UKF) estimator as default

config ESTIMATOR_COMPLEMENTARY
    bool "Complementary estimator"
    help
        Use the lightweight complementary estimator as default

endchoice

config ESTIMATOR_OOT
    bool "Out-of-tree estimator"
    default n

endmenu

menu "Motor configuration"

choice
    prompt "ESC protocol"
    default MOTORS_ESC_PROTOCOL_ONESHOT125

	config MOTORS_ESC_PROTOCOL_STANDARD_PWM
	    bool "Standard PWM"

	config MOTORS_ESC_PROTOCOL_ONESHOT125
	    bool "OneShot125"

	config MOTORS_ESC_PROTOCOL_ONESHOT42
	    bool "OneShot42"

  config MOTORS_ESC_PROTOCOL_DSHOT
      bool "Digital DSHOT protocol"

endchoice

choice
  prompt "DSHOT PWM Period"
  depends on MOTORS_ESC_PROTOCOL_DSHOT
  default MOTORS_DSHOT_PWM_300KHZ

config MOTORS_DSHOT_PWM_150KHZ
    bool "150 kHz"

config MOTORS_DSHOT_PWM_300KHZ
    bool "300 kHz"

config MOTORS_DSHOT_PWM_600KHZ
    bool "600 kHz"

endchoice

config MOTORS_ESC_PROTOCOL_DSHOT_BIDIRECTIONAL
  bool "Enable bi-directional DSHOT (RPM measurements)"
  depends on MOTORS_ESC_PROTOCOL_DSHOT
  default y
    help
        This requires 300 kHz DHOT PWM to work with Bluejay ESC FW.

config MOTORS_ARMING_RPM_MIN
    int "Minimum valid motor RPM during arming"
    depends on MOTORS_ESC_PROTOCOL_DSHOT_BIDIRECTIONAL
    range 0 65535
    default 1000
        help
                Minimum RPM that each motor must report to be considered valid
                during arming.

config MOTORS_ARMING_RPM_MAX
    int "Maximum valid motor RPM during arming"
    depends on MOTORS_ESC_PROTOCOL_DSHOT_BIDIRECTIONAL
    range 0 65535
    default 3500
        help
                Maximum RPM that each motor may report to be considered valid
                during arming.

config MOTORS_ARMING_RPM_DURATION_MS
    int "RPM validation duration during arming (ms)"
    depends on MOTORS_ESC_PROTOCOL_DSHOT_BIDIRECTIONAL
    range 0 10000
    default 200
        help
                Time in milliseconds that all motors must stay in the configured
                valid RPM range before arming can continue.

config MOTORS_RPM_NOT_RESPONDING_THRESHOLD
    int "Motor-not-responding RPM threshold"
    depends on MOTORS_ESC_PROTOCOL_DSHOT_BIDIRECTIONAL
    range 0 65535
    default 500
        help
                If a motor reports non-zero RPM below this threshold for long enough,
                it is considered not responding.
        
config MOTORS_NBR_OF_POLES
  int "Number of poles on the brushless motors"
  depends on MOTORS_ESC_PROTOCOL_DSHOT_BIDIRECTIONAL
  range 2 24
  default 12
    help
        This is used for RPM calculation and requires bi-directional DSHOT.

config MOTORS_REQUIRE_ARMING
    bool "Require arming to be able to start motors and take off"
    default n
    help
        When enabled, system must be armed to be able to take off. Arming can
        be done in several ways, e.g. though cfclient or external transmitter.

config MOTORS_DEFAULT_IDLE_THRUST
    int "Idle thrust for the armed motors"
    depends on MOTORS_REQUIRE_ARMING
    range 0 15000
    default 7000
    help
        Sets the baseline motor power level when they are armed. Setting this
        value above 7000 may cause the platform to move unintentionally, while
        setting it too low might not provide enough power to spin the motors.

config MOTORS_DEFAULT_PROP_TEST_PWM_RATIO
    int "Override default PWM ratio to use during motor tests"
    range 0 65535
    default 0
    help
        PWM ratio to use during motor tests, expressed as an integer in the range
        0 to 65535. Zero means not to override the PWM ratio; in this case, the
        drone uses full thrust for brushed motors and does not spin up brushless
        motors (for safety reasons). It is therefore advised to set this parameter
        explicitly for brushless builds to enable the motor test functionality.

        The value specified here can also be overridden with parameters.

config MOTORS_DEFAULT_BAT_TEST_PWM_RATIO
    int "Override default PWM ratio to use during battery tests"
    range 0 65535
    default 0
    help
        PWM ratio to use during battery test, expressed as an integer in the range
        0 to 65535. Zero means not to override the PWM ratio because there a differences
        between brushed and brushless;. Brushless is 0 for safety reasons. Different motors
        needs different value, hance this config variable.

        The value specified here can also be overridden with parameters.

choice
    prompt "Type of power distribution"
    default POWER_DISTRIBUTION_QUADROTOR

config POWER_DISTRIBUTION_QUADROTOR
    bool "Quadrotor power distribution"
    depends on PLATFORM_CF2 || PLATFORM_CF21BL|| PLATFORM_BOLT || PLATFORM_TAG
    help
        Power distribution function for quadrotors
config POWER_DISTRIBUTION_FLAPPER
    bool "Flapper Nimble+ power distribution"
    depends on PLATFORM_FLAPPER
    help
        Power distribution function for Flapper Nimble+

endchoice
config POWER_DISTRIBUTION_FLAPPER_REVB
    bool "Flapper  Nimble+ power distribution (PCB revision B)"
    depends on POWER_DISTRIBUTION_FLAPPER
    default n
    help
        Power distribution function for Flapper Nimble+ with revB PCB

config LOG_MOTOR_CAP_WARNING
    bool "Log a warning if the motor thrust is capped"
    default n
    help
        If the computed thrust of one or more motors is outside of the possible range, the thrust will be capped or
        reduced for one or more motors depending on configuration. Enabeling this setting will report in the console log
        that the thrust has been capped.

endmenu

menu "Supervisor configuration"

config SUPERVISOR_CRASH_DETECTION_G
    int "Crash detection (Gs)"
    range 0 20
    default 0
    help
        Maximum allowed deviation from 1 G when evaluating tumble/crash
        detection. A value of 0 disables the detection.

endmenu

menu "Parameter subsystem"

config PARAM_SILENT_UPDATES
    bool "Silent parameter updates"
    default n
    help
        Do not send CRTP packets when a parameter is updated. Note that this may
        break some functionality in clients that expect to receive feedback
        about parameter updates, so this option should be enabled if you know
        what you are doing.

config DEFRAG_STORAGE_ON_STARTUP
    bool "Defrag_on_startup"
    default y
    help
        This enables defragmentation of parameter storage memory everytime the
        CPU is started. It increases startup time, depending on
        fragmentation level.

endmenu

menu "API Service bridge"

config CRTP_APISERVICE
    bool "CRTP API Service bridge"
    default y
    help
        CRTP port 10 bridge that lets a client list the API Service endpoints,
        such as the Camera Deck, and send bitcraze.api requests to them.
        With no endpoint registered it serves an empty catalog.

config CRTP_APISERVICE_SLOTS
    int "Requests in flight"
    depends on CRTP_APISERVICE
    range 1 16
    default 4
    help
        Number of requests the bridge holds at once, across all endpoints.
        Reported to clients as max_in_flight.

config CRTP_APISERVICE_MAX_MESSAGE
    int "Largest API Service message, in bytes"
    depends on CRTP_APISERVICE
    range 64 1024
    default 256
    help
        Size of each request slot: the largest API Service message the bridge
        carries in either direction. Reported to clients as max_message.

config CRTP_APISERVICE_NOTIFY_BUFFER
    int "Buffer for forwarded notifications, in bytes"
    depends on CRTP_APISERVICE
    range 0 4096
    default 512
    help
        Bytes that hold the NOTIFY messages waiting to be sent to the client,
        for the endpoints it turned forwarding on for. Each message takes its
        length plus 3 bytes. When the buffer is full, messages are dropped and
        the client gets a NOTIFY_LOST event. 512 bytes hold about eight Camera
        Deck notifications. 0 turns notification forwarding off: SET_NOTIFY
        then answers ENOSYS.

endmenu
```
