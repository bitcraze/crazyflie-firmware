## Kconfig
```kconfig
mainmenu "Crazyflie Platform Configuration"

menu "Build and debug options"

config CROSS_COMPILE
    string "Cross-compiler tool prefix"
    default "arm-none-eabi-"
    help
        Same as running 'make CROSS_COMPILE=prefix-' but stored for
        default make runs in this application build directory.  You don't
        need to set this unless you want the configured application build
        directory to select the cross-compiler automatically.

config DEBUG
    bool "Enable debug build"
    default n
    help
        Enable debug symbols and extra output from firmware.

config DEBUG_QUEUE_MONITOR
    bool "Enable debug queue monitoring"
    depends on DEBUG
    default n
    help
        Enable the queue monitoring functionality.

config DEBUG_ENABLE_LED_MORSE
    bool "Enable blinking morse sequence with LEDs"
    default n
    help
        If enabled makes it possible to define LED sequences in form of the DOT,
        DASH, GAP, LETTER_GAP and WORD_GAP parts of Morse code.

config DEBUG_PRINT_ON_UART1
    bool "Switch DEBUG_PRINT to UART1"
    default n
    help
      Switch output of DEBUG_PRINT from radio to UART1.
      Note! This will interfere with several expansion decks, see the expansion
      deck documentation on https://www.bitcraze.io/ for more information about
      pin allocation.

config DEBUG_PRINT_ON_UART1_BAUDRATE
    int "Debug print on UART1 baudrate"
    default 115200
    depends on DEBUG_PRINT_ON_UART1
    help
      Set the baudrate of the debug output   


config DEBUG_DECK_IGNORE_OW
    bool "Do not enumerate OW based expansion decks"
    default n
    help
      Do not enumerate decks discovered by OneWire memory. This might be useful
      if one deck memory is very wrong. One could use the Crazyflie as a
      passive onewire memory writer.

endmenu

menu "Platform configuration"

choice
    prompt "Platform to build"
    default CONFIG_PLATFORM_CF2

config PLATFORM_CF2
    bool "Build for CF2"
    select SENSORS_BMI088_BMP388
    select SENSORS_MPU9250_LPS25H

config PLATFORM_BOLT
    bool "Build for Bolt"
    select SENSORS_BMI088_BMP388
    select SENSORS_BMI088_SPI

config PLATFORM_TAG
    bool "Build for the roadrunner"
    select SENSORS_BMI088_BMP388

config PLATFORM_FLAPPER
    bool "Build for Flapper Nimble+"
    select SENSORS_BMI088_BMP388
    select SENSORS_BMI088_SPI

endchoice

endmenu

menu "IMU configuration"

choice
    prompt "IMU algorithm"
    default IMU_MAHONY_QUATERNION

config IMU_MADGWICK_QUATERNION
    bool "Madgwick's AHRS and IMU algorithms"
    help
        Use Madgwick's IMU and AHRS algorithms.
        See: http://www.x-io.co.uk/open-source-ahrs-with-x-imu

config IMU_MAHONY_QUATERNION
    bool "Mahony IMU algorithm"
    help
        Use Mahony's algorithm from the paper:
        Nonlinear Complementary Filters on the Special Orthogonal Group
        See: https://ieeexplore.ieee.org/document/4608934

endchoice

endmenu

menu "Sensor configuration"

config SENSORS_MPU9250_LPS25H
    bool "Support for mpu9250 and lps25h sensors"
    default n
    help
        Include support for the Bosch bmi088 inertial and bmp388
        barometric sensors

config SENSORS_BMI088_BMP388
    bool "Support for bmi088 and bmp388 sensors"
    default n
    select SENSORS_BMI088_I2C
    help
        Include support for the Bosch bmi088 inertial and bmp388
        barometric sensors

config SENSORS_BOSCH
    bool "Include Bosch sensors"
    default n

config SENSORS_IGNORE_BAROMETER_FAIL
    bool "Ignore failure from barometer"
    depends on SENSORS_BMI088_BMP388
    default n

config SENSORS_BMI088_SPI
    bool "Support for SPI communincation with the bmi088 sensor"
    depends on SENSORS_BMI088_BMP388
    default n
    help
        Include support using SPI with the Bosch bmi088 inertial sensor

config SENSORS_BMI088_I2C
    bool "Support for I2C communincation with the bmi088 sensor"
    depends on SENSORS_BMI088_BMP388
    default n
    help
        Include support using I2C with the Bosch bmi088 inertial sensor

endmenu

source src/hal/src/Kconfig

menu "App layer configuration"

source "app_api/Kconfig"

config APP_ENABLE
    bool "Enable app entry point"
    default n
    help
        When enabled the firmware will call a function void appMain() from a
        task after the startup sequence has completed. This function should not
        return.

config APP_STACKSIZE
    int "Set the task stack size"
    depends on APP_ENABLE
    default 300
    help
        Size is in 32bit word (4 Bytes). The default is 300 (1.2KBytes)

config APP_PRIORITY
    int "Set the task priority"
    depends on APP_ENABLE
    default 0
    help
        Set the task priority between 0 and 5. Default is 0 (same as IDLE).

endmenu

menu "Expansion deck configuration"

config DECK_FORCE
    string "Force load specified custom deck driver"
    default "none"
    help
        A colon seperated list of custom drivers to force load or "none".

source src/deck/drivers/src/Kconfig

endmenu

source "src/modules/src/Kconfig"
```

## app_api/Kconfig
```kconfig
config APP_API_TEST
    bool "Build API test application"
    default n
    help
       Builds an application that uses all app layer API.
```

## configs/bolt_defconfig
```kconfig
CONFIG_PLATFORM_BOLT=y

CONFIG_ESTIMATOR_AUTO_SELECT=y
CONFIG_CONTROLLER_AUTO_SELECT=y

CONFIG_MOTORS_REQUIRE_ARMING=y
```

## configs/cf21bl_defconfig
```kconfig
CONFIG_PLATFORM_CF21BL=y

CONFIG_MOTORS_REQUIRE_ARMING=y
CONFIG_MOTORS_ESC_PROTOCOL_DSHOT=y
```

## configs/cfbl_defconfig
```kconfig
CONFIG_MOTORS_ESC_PROTOCOL_DSHOT=y

CONFIG_ESTIMATOR_AUTO_SELECT=y
CONFIG_CONTROLLER_AUTO_SELECT=y
```

## configs/flapper_defconfig
```kconfig
CONFIG_PLATFORM_FLAPPER=y

CONFIG_ESTIMATOR_AUTO_SELECT=y
CONFIG_CONTROLLER_PID=y

CONFIG_MOTORS_ESC_PROTOCOL_STANDARD_PWM=y

CONFIG_CONTROLLER_PID_FILTER_ALL=y
# CONFIG_CONTROLLER_PID_IMPROVED_BARO_Z_HOLD=y

CONFIG_DECK_FORCE="bcUSD:bcLedRing:bcFlapperDeck"
CONFIG_DECK_FLAPPER=y
CONFIG_DECK_USD=y
CONFIG_DECK_LEDRING=y

CONFIG_DECK_FLAPPER_EXTRX_ENABLE=n # Enable external receiver
CONFIG_DECK_CPPM=y
CONFIG_DECK_CPPM_USE_PA3=y

# CONFIG_DECK_EXTRX_ALT_HOLD=y
# CONFIG_DECK_EXTRX_ARMING=y

# CONFIG_DECK_LEDRING_DEFAULT_EFFECT=7
# CONFIG_DECK_LEDRING_NBR_LEDS=12

# Applicable when using CF2 as flight controller
# CONFIG_DECK_FLAPPER_MEASURE_VBAT_ON_PA3 # requires modification of the PCB: 10k / 1k voltage divider on PA3 and R44 removed

# For Flappers prior to 2022 (PCB revB)
# CONFIG_POWER_DISTRIBUTION_FLAPPER_REVB=y
```

## configs/spring_gripper_defconfig
```kconfig
CONFIG_PLATFORM_SPRING_GRIPPER=y

CONFIG_ESTIMATOR_AUTO_SELECT=y
CONFIG_CONTROLLER_PID=n
CONFIG_CONTROLLER_MLESO=y

CONFIG_MOTORS_ESC_PROTOCOL_STANDARD_PWM=y

CONFIG_CONTROLLER_PID_FILTER_ALL=y
# CONFIG_CONTROLLER_PID_IMPROVED_BARO_Z_HOLD=y

CONFIG_DECK_FLAPPER=y
CONFIG_POWER_DISTRIBUTION_FLAPPER=y
CONFIG_DECK_USD=y
CONFIG_DECK_SPRING_GRIPPER=y

CONFIG_DECK_FLAPPER_EXTRX_ENABLE=n # Enable external receiver
CONFIG_DECK_CPPM_USE_PA3=y
CONFIG_DECK_CPPM_USE_IO1=y
CONFIG_DECK_CPPM_USE_IO2=y

CONFIG_DEBUG=n
```

## configs/sysid_bl_defconfig
```kconfig
CONFIG_PLATFORM_CF21BL=y
CONFIG_MOTORS_REQUIRE_ARMING=y
CONFIG_MOTORS_ESC_PROTOCOL_DSHOT=y

CONFIG_DECK_RPM=y
CONFIG_DECK_LOADCELL=y
CONFIG_DECK_ACS37800=y
CONFIG_ENABLE_THRUST_BAT_COMPENSATED=y
CONFIG_DECK_FORCE="bcRpm:bcLoadcell:bcACS37800"
```

## configs/sysid_defconfig
```kconfig
CONFIG_PLATFORM_CF2=y
CONFIG_DECK_RPM=y
CONFIG_DECK_LOADCELL=y
CONFIG_DECK_ACS37800=y
CONFIG_ENABLE_THRUST_BAT_COMPENSATED=y
CONFIG_THRUST_BAT_COMPENSATION_TYPE=1
CONFIG_DECK_FORCE="bcRpm:bcLoadcell:bcACS37800"
```

## configs/tag_defconfig
```kconfig
CONFIG_PLATFORM_TAG=y

CONFIG_ESTIMATOR_AUTO_SELECT=y
CONFIG_CONTROLLER_AUTO_SELECT=y

CONFIG_DECK_FORCE="bcLoco"
CONFIG_SENSORS_IGNORE_BAROMETER_FAIL=y
```

## configs/wearable_defconfig
```kconfig
CONFIG_PLATFORM_CF2=y

CONFIG_ESTIMATOR_KALMAN=y
CONFIG_ESTIMATOR_KALMAN_GENERAL_PURPOSE=y
```

## examples/Kconfig
```kconfig
menu "Example applications"

choice
	prompt "Example application to build"
	default CONFIG_EXAMPLE_APPLICATION_NONE

config EXAMPLE_APPLICATION_NONE
    bool "Do not build any example application"

config EXAMPLE_APP_APPCHANNEL
    bool "Build appchannel application"

config EXAMPLE_APP_HELLO_WORLD
    bool "Build Hello World application"

config EXAMPLE_APP_INTERNAL_PARAM_LOG
    bool "Build internal param log application"

config EXAMPLE_APP_PEER_TO_PEER
    bool "Build peer-to-peer example application"

config EXAMPLE_DEMO_SWARM
    bool "Build the demo swarm application"

config EXAMPLE_DEMO_WALL_FOLLOWING
    bool "Build the demo wall following application"

endchoice

endmenu
```

## src/deck/backends/Kconfig
```kconfig
config DECK_FORCE
    string "Force load specified custom deck driver"
    default "none"
    help
        A colon seperated list of custom drivers to force load or "none".

config DECK_BACKEND_ONEWIRE
    bool "Enable OneWire deck discovery backend"
    default y
    help
        Enable the OneWire deck discovery backend that scans for decks with
        OneWire memory chips. Disable this if you want to ignore all
        OneWire-based deck discovery.

config DECK_BACKEND_DECKCTRL
    bool "Enable DeckCtrl deck discovery backend"
    default y
    help
        Enable the DeckCtrl deck discovery backend that scans for decks
        with DeckCtrl chip. Disable this if you want to ignore all
        DeckCtrl-based deck discovery.

config DECK_BACKEND_DECKCTRL_DEBUG
    depends on DECK_BACKEND_DECKCTRL
    bool "Enable DeckCtrl debug prints"
    default n
    help
      Enable debug prints for the deck controller subsystem.
      This will output additional information about deck detection,
      initialization, and communication for debugging purposes.

config DECK_BACKEND_DECKCTRL_MAX_DECKS
    depends on DECK_BACKEND_DECKCTRL
    int "Maximum number of DeckCtrl decks supported"
    range 1 12
    default 4
    help
      Set the maximum number of DeckCtrl decks that can be connected simultaneously.
      This limits the number of decks that can be enumerated and managed by the system.
      Increasing this number will increase RAM usage.
```
