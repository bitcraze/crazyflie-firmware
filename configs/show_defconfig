## configs/show_defconfig
```kconfig
CONFIG_PLATFORM_CF21BL=y
CONFIG_SYSLINK_RX_DMA=y
CONFIG_DECK_LIGHTHOUSE_MAX_N_BS=8
CONFIG_DECK_LOCODECK_USE_ALT_PINS=y
CONFIG_DECK_LOCO_ALGORITHM_TDOA3=y
CONFIG_DECK_LOCO_TDOA_RATE_LIMIT=y
CONFIG_MOTORS_ESC_PROTOCOL_DSHOT=y
CONFIG_MOTORS_DEFAULT_PROP_TEST_PWM_RATIO=10000
CONFIG_RADIO_ACTIVITY_TIMEOUT_MS=3000
CONFIG_SUPERVISOR_CRASH_DETECTION_G=2
CONFIG_DECK_LIGHTHOUSE_MAX_RATE=10
CONFIG_RADIO_ASSERT_ON_COM_PROBLEM=y

# Decks
CONFIG_DECK_ACTIVE_MARKER=n
CONFIG_DECK_AI=n
CONFIG_DECK_BUZZ=n
CONFIG_DECK_CPPM=n
CONFIG_DECK_FLAPPER=n
CONFIG_DECK_FLOW=y
CONFIG_DECK_GTGPS=n
CONFIG_DECK_LEDRING=n
CONFIG_DECK_LIGHTHOUSE=y
CONFIG_DECK_LOCO=y
CONFIG_DECK_LOCO_FULL_TX_POWER=y
CONFIG_DEBUG_TDOA_QUALITY=y
CONFIG_DECK_MULTIRANGER=y
CONFIG_DECK_OA=n
CONFIG_DECK_SERVO=n
CONFIG_DECK_USD=n
CONFIG_DECK_ZRANGER=n
CONFIG_DECK_ZRANGER2=n
CONFIG_DECK_ACS37800=n
CONFIG_DECK_RPM=n
CONFIG_DECK_LOADCELL=n
CONFIG_DECK_DECKCTRL_DEVBOARD=n
CONFIG_DECK_COLORLED=y
CONFIG_DECK_BCCAM=n
```

## src/hal/src/Kconfig
```kconfig
menu "Power management configuration"

config PM_AUTO_SHUTDOWN
    bool "Enable automatic shutdown"
    default n
    help
        The power management subsystem can automatically shutdown the system.
        The shutdown time in minutes is defined in platform_defaults_* for
        the specific platform and is the time since the last radio communication
        occurred.

endmenu

menu "Communication"

config SYSLINK_RX_DMA
    bool "Use DMA to receive uart syslink data instead of interrupts"
    default n
    help
        Using DMA to receive uart data reduces CPU load and will free
        up recources for other things. DMA is a shared resource though
        and might conflict with other functionality in the future.

config ENABLE_CPX
  bool "Enable CPX"
  select ENABLE_CPX_ON_UART2
  default y
  help
      This enables CPX routers and API

config ENABLE_CPX_ON_UART2
  bool "Enable CPX on UART2"
  depends on ENABLE_CPX
  default y
  help
      This enables CPX routing on UART2

config CPX_UART2_BAUDRATE
  int "CPX UART2 baudrate"
  depends on ENABLE_CPX_ON_UART2
  range 9600 2000000
  default 576000
  help
      Set the baudrate that will be used for CPX on UART2

config RADIO_ACTIVITY_TIMEOUT_MS
  int "Radio activity timeout (ms)"
  default 1000
  help
      Timeout in milliseconds since the last radio packet was received
      before the radio is considered inactive.

config RADIO_ASSERT_ON_COM_PROBLEM
  bool "Assert on radio communication problem"
  default y
  help
      In case of any radio communication problem, such as queue overflow 
      or checksum error, assert. This will make the Crazyflie cut the motor
      power so it might not be always wanted.

endmenu
```

## src/sim/Kconfig
```kconfig
menu "Simulation"
    depends on PLATFORM_SIM

choice
    prompt "Physics engine"
    default SIM_PHYSICS_ENGINE_BUILTIN

config SIM_PHYSICS_ENGINE_BUILTIN
    bool "Built-in physics engine"

endchoice

config SIM_BUILTIN_MASS_MG
    int "Mass without load (mg)"
    depends on SIM_PHYSICS_ENGINE_BUILTIN
    default 40000
    help
        Mass of the simulated Crazyflie in the built-in physics engine,
        without propeller guards. The inertia does not follow this value.

config SIM_BUILTIN_PROPELLER_GUARDS
    bool "Propeller guards"
    depends on SIM_PHYSICS_ENGINE_BUILTIN
    default n
    help
        Simulate a Crazyflie with propeller guards in the built-in physics
        engine: 4000 mg is added to the mass and the inertia is the one
        measured with guards.

config SIM_CRASH_SPEED_LIMIT_MM_S
    int "Crash speed limit (mm/s)"
    default 4000
    help
        Reaching ground level faster than this is a crash.

config SIM_CRASH_ANGLE_LIMIT_DEG
    int "Crash angle limit, pitch or roll (degrees)"
    default 45
    help
        Reaching ground level with pitch or roll beyond this is a crash.

config SIM_START_X_MM
    int "Start position x (mm)"
    default 0

config SIM_START_Y_MM
    int "Start position y (mm)"
    default 0

config SIM_START_YAW_DEG
    int "Start yaw (degrees)"
    default 0

endmenu
```
